## dts/bindings/lora/semtech,lr1110.yaml
```yaml
# Copyright (c) 2020 Andreas Sandberg
# SPDX-License-Identifier: Apache-2.0

description: Semtech LR1110 LoRa Modem

compatible: "semtech,lr1110"

include: spi-device.yaml

properties:
  reset-gpios:
    type: phandle-array
    description: |
      GPIO connected to the modem's NRESET signal.

      This signal is open-drain, active-low as interpreted by the
      modem.

  busy-gpios:
    required: true
    type: phandle-array
    description: |
      GPIO connected to the modem's BUSY signal.

  irq-gpios:
    required: true
    type: phandle-array
    description: |
      GPIO connected to IRQ.

  antenna-enable-gpios:
    type: phandle-array
    description: |
      Antenna power enable pin.

  tcxo-power-startup-delay-ms:
    type: int
    description: |
      Startup delay to let the TCXO stabilize after TCXO power on.
```
